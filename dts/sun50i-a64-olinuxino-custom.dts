// SPDX-License-Identifier: (GPL-2.0+ OR MIT)
// Copyright (C) 2023 Pavel Sorejs

/dts-v1/;

#include "allwinner/sun50i-a64-olinuxino.dts"
#include "sun50i-a64-olinuxino-hdmi-sound.dtsi"
#include "sun50i-a64-olinuxino-uext.dtsi"
#include "sun50i-a64-olinuxino-fix-thermal.dtsi"

/ {
	aliases {
		mmc0 = &mmc0;
	};
};
