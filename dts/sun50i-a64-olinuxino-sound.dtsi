// SPDX-License-Identifier: (GPL-2.0+ OR MIT)
// Copyright (C) 2023 Pavel Sorejs

&codec {
	status = "okay";
};

&codec_analog {
	cpvdd-supply = <&reg_eldo1>;
	status = "okay";
};

&dai {
	status = "okay";
};

&sound {
	simple-audio-card,aux-devs = <&codec_analog>;
	simple-audio-card,widgets = "Microphone", "Microphone Jack Left",
		    "Microphone", "Microphone Jack Right",
		    "Headphone", "Headphone Jack";
	simple-audio-card,routing = "Left DAC", "DACL",
		    "Right DAC", "DACR",
		    "Headphone Jack", "HP",
		    "ADCL", "Left ADC",
		    "ADCR", "Right ADC",
		    "Microphone Jack Left", "MBIAS",
		    "MIC1", "Microphone Jack Left",
		    "Microphone Jack Right", "MBIAS",
		    "MIC2", "Microphone Jack Right";
	status = "okay";
};
